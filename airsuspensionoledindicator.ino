#include <GyverOLED.h>

#define COUNT_CH 5 // добавить при необходимости. 5 заменить на 6, 7 и тд

struct state
{    
  bool current;
  unsigned long prevTime;
  int pin;
  uint8_t* bitmap;
};

bool isBuffered = false;

state values[COUNT_CH];
GyverOLED<SSD1306_128x64, OLED_NO_BUFFER> oled;
byte currentImage = COUNT_CH;
byte readDelay = 100;

const uint8_t bitmap_1[] PROGMEM = {
	0x00, 0x00, 0x00, 0x00, 0x00, 0x00, 0x00, 0x00, 0x00, 0x00, 0x00, 0x00,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 0x00, 
	0x00, 0x00, 0x00, 0x00, 0x00, 0x00, 0x00, 0x00, 0x00, 0x00, 0x00, 0x00,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 0x00, 
	0x00, 0x00, 0x00, 0x00, 0x00, 0x00, 0x00, 0x00, 0x00, 0x00, 0x00, 0x00,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 0x00, 
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	0x00, 0x00, 0x00, 0x00, 0x00, 0x00, 0x00, 0x00, 0x00, 0x00, 0x00, 0x00,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 0x00, 
};

const uint8_t bitmap_2[] PROGMEM = {
	0x00, 0x00, 0x00, 0x00, 0x00, 0x00, 0x00, 0x00, 0x00, 0x00, 0x00, 0x00,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 0x00, 
	0x00, 0x00, 0x00, 0x00, 0x00, 0x00, 0x00, 0x00, 0x00, 0x00, 0x00, 0x00,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 0x00, 
	0x00, 0x00, 0x00, 0x00, 0x00, 0x00, 0x00, 0x00, 0x00, 0x00, 0x00, 0x00,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 0x00, 
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	0x00, 0x00, 0x00, 0x00, 0x00, 0x00, 0x00, 0x00, 0x00, 0x00, 0x00, 0x00,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 0x00, 
};

const uint8_t bitmap_3[] PROGMEM = {
	0x00, 0x00, 0x00, 0x00, 0x00, 0x00, 0x00, 0x00, 0x00, 0x00, 0x00, 0x00,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 0x00, 
	0x00, 0x00, 0x00, 0x00, 0x00, 0x00, 0x00, 0x00, 0x00, 0x00, 0x00, 0x00,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 0x00, 
	0x00, 0x00, 0x00, 0x00, 0x00, 0x00, 0x00, 0x00, 0x00, 0x00, 0x00, 0x00,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 0x00, 
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	0x00, 0x00, 0x00, 0x00, 0x00, 0x00, 0x00, 0x00, 0x00, 0x00, 0x00, 0x00,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 0x00, 
};

const uint8_t bitmap_4[] PROGMEM = {
	0x00, 0x00, 0x00, 0x00, 0x00, 0x00, 0x00, 0x00, 0x00, 0x00, 0x00, 0x00,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 0x00, 
	0x00, 0x00, 0x00, 0x00, 0x00, 0x00, 0x00, 0x00, 0x00, 0x00, 0x00, 0x00,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 0x00, 
	0x00, 0x00, 0x00, 0x00, 0x00, 0x00, 0x00, 0x00, 0x00, 0x00, 0x00, 0x00,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 0x00, 
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	0x00, 0x00, 0x00, 0x00, 0x00, 0x00, 0x00, 0x00, 0x00, 0x00, 0x00, 0x00,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 0x00, 
};

const uint8_t bitmap_5[] PROGMEM = {
	0x00, 0x00, 0x00, 0x00, 0x00, 0x00, 0x00, 0x00, 0x00, 0x00, 0x00, 0x00,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 0x00, 
	0x00, 0x00, 0x00, 0x00, 0x00, 0x00, 0x00, 0x00, 0x00, 0x00, 0x00, 0x00,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 0x00, 
	0x00, 0x00, 0x00, 0x00, 0x00, 0x00, 0x00, 0x00, 0x00, 0x00, 0x00, 0x00,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 0x00, 
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	0x00, 0x00, 0x00, 0x00, 0x00, 0x00, 0x00, 0x00, 0x00, 0x00, 0x00, 0x00,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 0x00, 
};

// добавить bitmap_n по аналогии как выше. Массив получен с помощью ImageProcessor 128 * 64

void setup() {
  Serial.begin(9600);
  oled.init();        // инициализация
  oled.clear();       // очистка
  if(isBuffered)
  {
    oled.update();
  }

  values[0].pin = A0;
  values[0].bitmap = bitmap_1;

  values[1].pin = A1;
  values[1].bitmap = bitmap_2;

  values[2].pin = A2;  
  values[2].bitmap = bitmap_3;

  values[3].pin = A3;
  values[3].bitmap = bitmap_4;

  values[4].pin = A6;
  values[4].bitmap = bitmap_5; 

  // добавить 2 строки как выше с указанием пина и изображения
  // values[5].pin = A7;
  // values[5].bitmap = bitmap_6;  

  for(int i = 0; i < COUNT_CH; ++i)
  {  
     pinMode(values[i].pin, INPUT);
  }

  Serial.println("Started");
}

void loop() {
  unsigned long nowT = millis();
  for(int i = 0; i < COUNT_CH; ++i)
  {    
    if(nowT - values[i].prevTime >= readDelay)
    {  
      bool active = analogRead(values[i].pin) * 5.0 / 1024.0 > 2.5;
      if(active != values[i].current)
      {
        values[i].current = active;
        values[i].prevTime = nowT;
        Serial.print("Pin ");
        Serial.print(values[i].pin);
        Serial.print(" changed state to ");        
        Serial.println(active ? "true" : "false");        
      }
    }
  }

  byte stateImage = values[0].current ? 0 : COUNT_CH;
  for(int i = 1; i < COUNT_CH; ++i)
  { 
    stateImage = values[i].current ? i : stateImage;
  }

  if(currentImage != stateImage)
  {
    oled.clear();

    if(stateImage < COUNT_CH)
    {
      oled.drawBitmap(0, 0, values[stateImage].bitmap, 128, 64, BITMAP_NORMAL, BUF_ADD);
    }
    
    if(isBuffered)
    {
      oled.update();
    }

    currentImage = stateImage;
    Serial.println("Redrawed");    
  }
}
